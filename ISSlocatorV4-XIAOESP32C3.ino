/*********************************************************************
ISS Locator for XIAO ESP32C3 with Japan Alert
Target Hardware: Seeed Studio XIAO ESP32C3
Includes: OLED SSD1306, NeoPixels, Buzzer
*********************************************************************/

#include <SPI.h>
#include <Wire.h>
#include <Adafruit_GFX.h>
#include <Adafruit_SSD1306.h>
#include <WiFi.h>
#include <HTTPClient.h>
#include <ArduinoJson.h> 
#include <WiFiManager.h> 
#include <Adafruit_NeoPixel.h> 
#include <stdlib.h> // Required for atof()

#include "myID.h"
#include "config.h" 

#define SCREEN_WIDTH 128 
#define SCREEN_HEIGHT 64 
#define OLED_RESET     -1 
#define SCREEN_ADDRESS 0x3C 

Adafruit_SSD1306 display(SCREEN_WIDTH, SCREEN_HEIGHT, &Wire, OLED_RESET);
Adafruit_NeoPixel pixels(NUM_LEDS, NEOPIXEL_PIN, NEO_GRB + NEO_KHZ800);

// 'woldmap3', 128x64px (Bitmap data omitted for brevity, keep your existing array here)
const unsigned char epd_bitmap_woldmap3 [] PROGMEM = {
  0x00, 0x00, 0x00, 0x00, 0x00, 0x00, 0x00, 0x00, 0x00, 0x00, 0x00, 0x00, 0x00, 0x00, 0x00, 0x00, 
  0x00, 0x00, 0x00, 0x00, 0x00, 0x00, 0x00, 0x00, 0x00, 0x00, 0x00, 0x00, 0x00, 0x00, 0x00, 0x00, 
  0x00, 0x00, 0x00, 0x00, 0x0f, 0x00, 0xfe, 0x00, 0x00, 0x00, 0x00, 0x00, 0x00, 0x00, 0x00, 0x00, 
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  0xff, 0xff, 0xff, 0xff, 0xff, 0xff, 0xff, 0xff, 0xff, 0xff, 0xff, 0xff, 0xff, 0xff, 0xff, 0xff
}; 

const String endpoint = "http://api.open-notify.org/iss-now.json";

// =========================================================================
// LOCAL CONVERSION FUNCTION
// =========================================================================
float convertToFloat(const char* str) {
  if (str == nullptr) {
    Serial.println("Error: String is null");
    return 0.0f;
  }
  return (float)atof(str); // Standard C function: ASCII to Float
}
// =========================================================================

bool isOverJapan(float lat, float lon) {
  return (lat >= 24.0 && lat <= 46.0 && lon >= 122.0 && lon <= 154.0);
}

void triggerAlert(bool active) {
  if (active) {
    for (int i = 0; i < NUM_LEDS; i++) {
      pixels.setPixelColor(i, pixels.Color(255, 0, 0)); 
    }
    pixels.show();
    digitalWrite(BUZZER_PIN, HIGH);
    delay(100); 
    digitalWrite(BUZZER_PIN, LOW);
  } else {
    pixels.clear();
    pixels.show();
    digitalWrite(BUZZER_PIN, LOW);
  }
}

void disp(String latitude, String longitude, bool alertActive) {
  int lat10, long10;
  int x, y;
  
  display.clearDisplay();
  display.drawBitmap(0, 0, epd_bitmap_woldmap3, 128, 64, WHITE);
  
  display.setTextSize(1);             
  display.setTextColor(SSD1306_BLACK, SSD1306_WHITE); 
  display.setCursor(2, 56);             
  display.print(latitude);
  display.print(", ");
  display.print(longitude);
  display.display();

  lat10 = int(latitude.toFloat() * 10.0);
  long10 = int(longitude.toFloat() * 10.0);
  x = map(long10, -1800, 1800, 0, 128);
  y = map(lat10, 900, -900, 0, 64);

  for (int i = 0; i < 10; i++) {
    display.drawPixel(x, y, SSD1306_WHITE);
    display.drawPixel(x - 1, y, SSD1306_WHITE);
    display.drawPixel(x + 1, y, SSD1306_WHITE);
    display.drawPixel(x, y - 1, SSD1306_WHITE);
    display.drawPixel(x, y + 1, SSD1306_WHITE);
    display.display();
    
    if (alertActive && (i % 6 == 0)) {
      triggerAlert(true);
    }

    delay(500);
    
    display.drawPixel(x, y, SSD1306_BLACK);
    display.drawPixel(x - 1, y, SSD1306_BLACK);
    display.drawPixel(x + 1, y, SSD1306_BLACK);
    display.drawPixel(x, y - 1, SSD1306_BLACK);
    display.drawPixel(x, y + 1, SSD1306_BLACK);
    display.display();
    
    delay(500); 
  }
}

void setup() {
  WiFi.mode(WIFI_STA); 
  Serial.begin(SERIAL_BAUD);
  
  pinMode(BUZZER_PIN, OUTPUT);
  digitalWrite(BUZZER_PIN, LOW);

  pixels.begin();
  pixels.clear();
  pixels.show();

  Wire.begin(OLED_SDA, OLED_SCL);

  WiFiManager wm;
  bool res = wm.autoConnect("AutoConnectAP"); 

  if (!res) {
    Serial.println("Failed to connect");
  } else {
    Serial.println("connected...yeey :)");
  }
  
  display.begin(SSD1306_SWITCHCAPVCC, SCREEN_ADDRESS);
  display.clearDisplay(); 
  display.drawBitmap(0, 0, epd_bitmap_woldmap3, 128, 64, WHITE);
  display.display();
}

void loop() {
  if ((WiFi.status() == WL_CONNECTED)) {
    HTTPClient http;
    http.begin(endpoint); 
    int httpCode = http.GET();  
    if (httpCode > 0) { 
      String payload = http.getString();  
      JsonDocument ISSlocation;
      DeserializationError jsonerror = deserializeJson(ISSlocation, payload);

      if (!jsonerror) {
        // 1. Extract the data as C-strings (const char*)
        const char* latStr = ISSlocation["iss_position"]["latitude"].as<const char*>();
        const char* lonStr = ISSlocation["iss_position"]["longitude"].as<const char*>();
        
        // 2. Use the local function to convert those strings to floats
        float lat = convertToFloat(latStr);
        float lon = convertToFloat(lonStr);

        Serial.printf("Converted -> Latitude: %f, Longitude: %f\n", lat, lon);

        bool overJapan = isOverJapan(lat, lon);
        
        if (!overJapan) {
          triggerAlert(false); 
        }

        // We pass the original strings to disp() to keep the coordinate formatting
        disp(String(latStr), String(lonStr), overJapan);
      }
    } 
    else {
      Serial.println("Error on HTTP request");
    }
    http.end(); 
  }
}
